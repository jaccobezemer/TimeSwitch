## main/Kconfig.projbuild
```kconfig
menu "TimeSwitch Configuration"

config TIMESWITCH_HOSTNAME
    string "Device hostname (mDNS/DHCP)"
    default "timeswitch"

config TIMESWITCH_WIFI_SSID
    string "Default WiFi SSID (leeg = captive portal)"
    default ""

config TIMESWITCH_WIFI_PASSWORD
    string "Default WiFi wachtwoord"
    default ""

config TIMESWITCH_NTP_SERVER
    string "NTP server adres"
    default "pool.ntp.org"

config TIMESWITCH_TIMEZONE
    string "Tijdzone POSIX string"
    default "CET-1CEST,M3.5.0,M10.5.0/3"
    help
        Midden-Europese tijd met zomertijd.

endmenu
```

## sdkconfig.defaults
```kconfig
CONFIG_IDF_TARGET="esp32"
CONFIG_ESPTOOLPY_FLASHSIZE_4MB=y
CONFIG_PARTITION_TABLE_CUSTOM=y
CONFIG_PARTITION_TABLE_CUSTOM_FILENAME="partitions.csv"
CONFIG_XPT2046_INTERRUPT_MODE=y
CONFIG_HTTPD_WS_SUPPORT=y
```
